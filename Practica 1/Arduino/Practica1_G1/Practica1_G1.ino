#include "LedControl.h"

LedControl matriz = LedControl(13,11,12,1); 

void setup() {
	for (int i = 0; i <= 7; i++)
		pinMode(i, OUTPUT);
	for (int i = 14; i <= 21; i++)
		pinMode(i, OUTPUT);
	for (int i = 0; i <= 7; i++)
		digitalWrite(i, HIGH);
	for (int i = 14; i <= 21; i++)
		digitalWrite(i, LOW);

	//  INICIALIZAR MATRIZ CON DRIVER
	matriz.shutdown(0, false);
	matriz.setIntensity(0, 8); 
}

int tamMensajeX = 168;
int tamMensajeY = 8;
byte mensaje[8][168] = {{0, 0, 0, 0, 1, 0, 1, 1, 1, 1, 0, 0, 1,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 0, 0 },
                        {0, 0, 0, 1, 0, 0, 1, 0, 0, 0, 1, 0, 1,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 0, 0 },
                        {0, 0, 1, 0, 0, 0, 1, 0, 0, 0, 1, 0, 1,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 0, 0 },
                        {0, 1, 0, 0, 0, 0, 1, 1, 1, 1, 0, 0, 1,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 1, 0 },
                        {0, 1, 0, 0, 0, 0, 1, 0, 0, 0, 0, 0, 1,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 1, 0 },
                        {0, 0, 1, 0, 0, 0, 1, 0, 0, 0, 0, 0, 1,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 0, 0 },
                        {0, 0, 0, 1, 0, 0, 1, 0, 0, 0, 0, 0, 1,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 0, 0 },
                        {0, 0, 0, 0, 1, 0, 1, 0, 0, 0, 0, 0, 1,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 0, 0 } };

int offset = 0;

void encenderLed(int x, int y) {
	digitalWrite(y, LOW);
	digitalWrite(14 + x, HIGH);
	delayMicroseconds(1000);
	digitalWrite(y, HIGH);
	digitalWrite(14 + x, LOW);
}

void pintarLed(int x, int y) {
	if (x >= 0 && x <= 7)
		encenderLed(x, y); // manipulo matriz sin driver
	else if (x >= 8 && x <= 15)
		matriz.setLed(0, y, x - 8, true); //  " " con driver
}

void borrarLed(int x, int y) {
	if (x >= 8 && x <= 15)
		matriz.setLed(0, y, x - 8, false); //  " " con driver
}

void actualizarMatrizSinDriver () {
	for (int i = 0; i < tamMensajeY; i++)
		for(int j = 0; j < tamMensajeX; j++) {
			if (mensaje[i][j] == 1)
				pintarLed((j + offset) % 168, i);
		}
}

byte estado[8][16] = { { 0, 0, 0, 0, 0, 0, 0, 0, 0, 0, 0, 0, 0, 0, 0, 0 }, \
                       { 0, 0, 0, 0, 0, 0, 0, 0, 0, 0, 0, 0, 0, 0, 0, 0 }, \
                       { 0, 0, 0, 0, 0, 0, 0, 0, 0, 0, 0, 0, 0, 0, 0, 0 }, \
                       { 0, 0, 0, 0, 0, 0, 0, 0, 0, 0, 0, 0, 0, 0, 0, 0 }, \
                       { 0, 0, 0, 0, 0, 0, 0, 0, 0, 0, 0, 0, 0, 0, 0, 0 }, \
                       { 0, 0, 0, 0, 0, 0, 0, 0, 0, 0, 0, 0, 0, 0, 0, 0 }, \
                       { 0, 0, 0, 0, 0, 0, 0, 0, 0, 0, 0, 0, 0, 0, 0, 0 }, \
                       { 0, 0, 0, 0, 0, 0, 0, 0, 0, 0, 0, 0, 0, 0, 0, 0 }, };

bool direccion = true; // true -> derecha | false -> izquierda
bool modo = false; // true-> sin mov | false -> con mov
int velocidad = 1;
int potenciometro = 0;

void mostrarMensaje() {
  if (digitalRead(53) == LOW) {
    for (int i = 0; i < tamMensajeY; i++)
      for (int j = 0; j < tamMensajeX; j++) {
        if (mensaje[i][j] == 1) {
          int residuo = (j + offset) % tamMensajeX;
          pintarLed(residuo < 0 ? residuo + tamMensajeX : residuo, i);
        }
      }
    //                   vv
    // analogRead(A0);
    // 0  - 1023 -- entrada análoga
    // 1  -   15 -- velocidad
    //                   ||
    //                   ||
    //                   vv
    potenciometro = analogRead(A0);
    velocidad = map(potenciometro, 0, 1024, 1, 15);
    for (int i = 0; i <= 3 + (2 * velocidad); i++) {
      actualizarMatrizSinDriver();
      delayMicroseconds(80);
    }
    matriz.clearDisplay(0);
    if (digitalRead(52) == LOW)
      offset++;
    else
      offset--;
  } else if (digitalRead(53) == HIGH) {
    for (int k = 0; k < 28 && k >= 0;) {
      if (digitalRead(52) == HIGH) {
        if (k < 28)
          k++;
        else k=0;
      } else {
        if (k > 0)
          k--;
        else k=27;
      }
      for (int i = 0; i < 8; i++) {
        for (int j = 6 * k; j < (6 * k) + 6; j++) {
          if (mensaje[i][j] == 1) {
            pintarLed((j % 6) + 8, i);
          }
        }
      }
      potenciometro = analogRead(A0);
      velocidad = map(potenciometro, 0, 1024, 1, 15);
      for (int i = 0; i <= 10 + (2 * velocidad); i++) {
        delay(30);
      }
      matriz.clearDisplay(0);
      if (digitalRead(53) == LOW)
        break;
    }
  }
}

void loop() {
  mostrarMensaje();
}
